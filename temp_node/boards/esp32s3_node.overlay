/ {
    aliases {
        temp-sensor = &ds18b20;
    };

    ds18b20: temp-sensor {
        compatible = "maxim,ds18b20";
        gpios = <&gpio0 5 (GPIO_ACTIVE_HIGH | GPIO_PULL_UP)>;
        status = "okay";
    };
};
