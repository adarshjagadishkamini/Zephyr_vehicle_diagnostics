## CMakeLists.txt
```
cmake_minimum_required(VERSION 3.20.0)
set(BOARD esp32s3_devkitm)
set(DTC_OVERLAY_FILE ${CMAKE_CURRENT_SOURCE_DIR}/boards/esp32s3_node.overlay)

find_package(Zephyr REQUIRED HINTS $ENV{ZEPHYR_BASE})
project(battery_node)

target_sources(app PRIVATE src/main.c)
target_include_directories(app PRIVATE
    ${CMAKE_CURRENT_SOURCE_DIR}/../common/can_protocol
    ${CMAKE_CURRENT_SOURCE_DIR}/../common/sensor_utils
)
```

## prj.conf
```kconfig
CONFIG_I2C=y
CONFIG_CAN=y
CONFIG_SENSOR=y
CONFIG_WATCHDOG=y
```

## src/main.c
```c
#include <zephyr/kernel.h>
#include <zephyr/drivers/i2c.h>
#include <zephyr/drivers/can.h>
#include "sensor_common.h"
#include "can_ids.h"

#define INA219_ADDR 0x40
#define INA219_CONFIG_REG 0x00
#define INA219_CURRENT_REG 0x04
#define INA219_VOLTAGE_REG 0x02

static const struct device *i2c_dev;
static const struct device *can_dev;

static void battery_thread(void *arg1, void *arg2, void *arg3)
{
    uint8_t can_data[BATTERY_MSG_LEN];
    int16_t current_raw, voltage_raw;
    float voltage, current;

    while (1) {
        // Read voltage and current from INA219
        i2c_burst_read(i2c_dev, INA219_ADDR, INA219_VOLTAGE_REG, (uint8_t *)&voltage_raw, 2);
        i2c_burst_read(i2c_dev, INA219_ADDR, INA219_CURRENT_REG, (uint8_t *)&current_raw, 2);

        voltage = voltage_raw * 0.00125f; // LSB = 1.25mV
        current = current_raw * 0.0005f;  // LSB = 0.5mA

        memcpy(can_data, &voltage, sizeof(float));
        send_sensor_data(can_dev, CAN_ID_BATTERY, can_data, BATTERY_MSG_LEN);

        k_sleep(K_MSEC(1000));
    }
}

void main(void) {
    i2c_dev = DEVICE_DT_GET(DT_ALIAS(i2c_sens));
    can_dev = DEVICE_DT_GET(DT_CHOSEN(zephyr_canbus));

    if (!device_is_ready(i2c_dev) || !device_is_ready(can_dev)) {
        return;
    }

    // Configure INA219
    uint16_t config = 0x399F; // 32V, ±2A range
    uint8_t config_data[2] = {config >> 8, config & 0xFF};
    i2c_write(i2c_dev, config_data, 2, INA219_ADDR);

    k_thread_create(&battery_thread_data, battery_stack,
                   SENSOR_THREAD_STACK_SIZE,
                   battery_thread, NULL, NULL, NULL,
                   SENSOR_THREAD_PRIORITY, 0, K_NO_WAIT);
}
```
