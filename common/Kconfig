## common/Kconfig
```kconfig
menu "Safety Features"

config ASIL_MONITOR
    bool "Enable ASIL-B Safety Monitor"
    default y
    help
        Enable ASIL-B compliance monitoring features

config TASK_MONITOR
    bool "Enable Task Monitoring"
    default y
    help
        Enable task deadline and runtime monitoring

config MEMORY_PROTECTION
    bool "Enable Memory Protection"
    default y
    help
        Enable MPU-based memory protection features

config RUNTIME_STATS
    bool "Enable Runtime Statistics"
    default y
    help
        Enable collection of runtime statistics

endmenu
```

## temp_node/Kconfig
```kconfig
menu "Temperature Node Configuration"

config TEMP_SENSOR_INTERVAL
    int "Temperature reading interval in milliseconds"
    default 1000
    help
        How often to read temperature values

endmenu

source "Kconfig.zephyr"
```

## west.yml
```yaml
manifest:
  version: 0.7
  projects:
    - name: zephyr
      url: https://github.com/zephyrproject-rtos/zephyr
      revision: v3.5.0
      import: true
    - name: esp32_modules
      url: https://github.com/espressif/esp-idf
      revision: v4.4.5
      path: modules/esp32
```
