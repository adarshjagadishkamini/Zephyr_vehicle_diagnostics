## prj.conf
```kconfig
CONFIG_NETWORKING=y
CONFIG_NET_IPV4=y
CONFIG_NET_TCP=y
CONFIG_NET_SOCKETS=y
CONFIG_NET_SOCKETS_POSIX_NAMES=y

CONFIG_WIFI=y
CONFIG_WIFI_ESP32=y

CONFIG_MQTT_LIB=y
CONFIG_MQTT_LIB_TLS=y
CONFIG_NET_SOCKETS_SOCKOPT_TLS=y
CONFIG_MBEDTLS=y
CONFIG_MBEDTLS_BUILTIN=y
CONFIG_MBEDTLS_ENABLE_HEAP=y
CONFIG_MBEDTLS_SSL_MAX_CONTENT_LEN=4096

CONFIG_BT=y
CONFIG_BT_PERIPHERAL=y
CONFIG_BT_DIS=y
CONFIG_BT_SMP=y

CONFIG_CAN=y
CONFIG_CAN_AUTO_BUS_OFF_RECOVERY=y
```

## src/main.c
```c
#include <zephyr/kernel.h>
#include <zephyr/net/mqtt.h>
#include <zephyr/bluetooth/bluetooth.h>
#include <zephyr/bluetooth/gatt.h>
#include <zephyr/drivers/can.h>
#include "can_ids.h"

// BLE UUIDs for WiFi configuration
#define WIFI_CONFIG_UUID BT_UUID_DECLARE_16(0x00FF)
#define WIFI_SSID_CHAR_UUID BT_UUID_DECLARE_16(0x00F1)
#define WIFI_PASS_CHAR_UUID BT_UUID_DECLARE_16(0x00F2)

#define STACK_SIZE 4096
#define PRIORITY 5

// Global MQTT client
static struct mqtt_client mqtt_client;
static struct k_work_delayable mqtt_work;
static struct bt_conn *current_conn;

// BLE service for WiFi configuration
BT_SERVICE_DEFINE(wifi_svc,
    BT_GATT_PRIMARY_SERVICE(WIFI_CONFIG_UUID),
    BT_GATT_CHARACTERISTIC(WIFI_SSID_CHAR_UUID,
        BT_GATT_CHRC_WRITE,
        BT_GATT_PERM_WRITE,
        NULL, wifi_ssid_write, NULL),
    BT_GATT_CHARACTERISTIC(WIFI_PASS_CHAR_UUID,
        BT_GATT_CHRC_WRITE,
        BT_GATT_PERM_WRITE,
        NULL, wifi_pass_write, NULL),
);

// Wifi configuration callbacks
static ssize_t wifi_ssid_write(struct bt_conn *conn,
                              const struct bt_gatt_attr *attr,
                              const void *buf, uint16_t len,
                              uint16_t offset, uint8_t flags) {
    static char ssid[MAX_SSID_LEN];
    
    if (offset + len > sizeof(ssid)) {
        return BT_GATT_ERR(BT_ATT_ERR_INVALID_OFFSET);
    }

    memcpy(ssid + offset, buf, len);
    
    if (offset + len == strlen(ssid)) {
        store_wifi_credentials(ssid, NULL);
    }
    
    return len;
}

static ssize_t wifi_pass_write(struct bt_conn *conn,
                              const struct bt_gatt_attr *attr,
                              const void *buf, uint16_t len,
                              uint16_t offset, uint8_t flags) {
    static char password[MAX_PSK_LEN];
    
    if (offset + len > sizeof(password)) {
        return BT_GATT_ERR(BT_ATT_ERR_INVALID_OFFSET);
    }

    memcpy(password + offset, buf, len);
    
    if (offset + len == strlen(password)) {
        store_wifi_credentials(NULL, password);
        wifi_connect(get_stored_ssid(), password);
    }
    
    return len;
}

// CAN message handler with complete switch case
static void can_handler(const struct device *dev, struct can_frame *frame, void *user_data) {
    switch(frame->id) {
        case CAN_ID_TEMP: {
            float temp;
            memcpy(&temp, frame->data, sizeof(float));
            publish_sensor_data(TOPIC_TEMPERATURE, temp);
            if (temp > 90.0f) {
                publish_sensor_data(TOPIC_PREDICTIVE_MAINTENANCE, temp);
            }
            break;
        }
        case CAN_ID_GPS: {
            float lat, lon;
            memcpy(&lat, frame->data, sizeof(float));
            memcpy(&lon, frame->data + sizeof(float), sizeof(float));
            publish_gps_data(TOPIC_GPS, lat, lon);
            broadcast_v2v_data(V2V_GPS_DATA, frame->data, frame->dlc);
            break;
        }
        case CAN_ID_COLLISION: {
            uint16_t distance;
            distance = (frame->data[0] << 8) | frame->data[1];
            publish_sensor_data(TOPIC_COLLISION, (float)distance);
            if (distance < 100) { // Less than 1 meter
                char hazard_msg[64];
                snprintf(hazard_msg, sizeof(hazard_msg), 
                         "Critical: Collision warning at %d cm", distance);
                publish_sensor_data(TOPIC_HAZARD_NOTIFICATION, distance);
                broadcast_v2v_data(V2V_HAZARD_DATA, (uint8_t*)hazard_msg, strlen(hazard_msg));
            }
            break;
        }
        case CAN_ID_BATTERY: {
            float voltage;
            memcpy(&voltage, frame->data, sizeof(float));
            publish_sensor_data(TOPIC_BATTERY, voltage);
            break;
        }
        case CAN_ID_BRAKE: {
            uint16_t pressure;
            pressure = (frame->data[0] << 8) | frame->data[1];
            publish_sensor_data(TOPIC_BRAKE, (float)pressure);
            broadcast_v2v_data(V2V_BRAKE_DATA, frame->data, frame->dlc);
            break;
        }
        case CAN_ID_TPMS: {
            uint8_t pressure = frame->data[0];
            publish_sensor_data(TOPIC_TPMS, (float)pressure);
            break;
        }
        case CAN_ID_SPEED: {
            uint16_t speed;
            speed = (frame->data[0] << 8) | frame->data[1];
            publish_sensor_data(TOPIC_SPEED, (float)speed);
            broadcast_v2v_data(V2V_SPEED_DATA, frame->data, frame->dlc);
            break;
        }
    }
}

// MQTT Connection callback
static void mqtt_event_cb(struct mqtt_client *client,
                         struct mqtt_evt *evt) {
    switch (evt->type) {
        case MQTT_EVT_CONNACK:
            subscribe_to_topics();
            break;
        case MQTT_EVT_DISCONNECT:
            handle_error(ERROR_MQTT_DISCONNECT);
            break;
        // Add other MQTT event handling
    }
}

void main(void) {
    int err;

    // Initialize error handling
    error_handler_init();

    // Initialize secure boot
    if (secure_boot_init() != 0) {
        handle_error(ERROR_SECURE_BOOT);
        return;
    }

    // Initialize BLE
    err = bt_enable(NULL);
    if (err) {
        handle_error(ERROR_BLE_FAIL);
        return;
    }

    // Initialize V2X
    v2x_init();

    // Initialize CAN
    const struct device *can_dev = DEVICE_DT_GET(DT_CHOSEN(zephyr_canbus));
    if (!device_is_ready(can_dev)) {
        return;
    }

    // Set up CAN filter to receive all sensor messages
    struct can_filter filter = {
        .id = 0,
        .mask = 0,
        .flags = CAN_FILTER_DATA
    };
    can_add_rx_filter(can_dev, can_handler, NULL, &filter);

    // Initialize MQTT
    mqtt_client_init(&mqtt_client);
    k_work_init_delayable(&mqtt_work, mqtt_connect_work_handler);

    // Main event loop
    while (1) {
        watchdog_feed();
        k_sleep(K_SECONDS(1));
    }
}
```

## src/dns_client.c
```c
#include "dns_client.h"
#include <zephyr/net/dns_resolve.h>

#define DNS_RESOLVE_TIMEOUT_MS 5000

static struct dns_resolve_context dns_ctx;

int dns_init(void) {
    return dns_resolve_init(&dns_ctx);
}

int dns_resolve_hostname(const char *hostname, struct sockaddr *addr) {
    struct dns_addrinfo info;
    int ret;

    ret = dns_resolve_name(&dns_ctx, hostname, DNS_QUERY_TYPE_A,
                          K_MSEC(DNS_RESOLVE_TIMEOUT_MS), &info);
    if (ret == 0) {
        memcpy(addr, &info.ai_addr, sizeof(struct sockaddr));
    }
    return ret;
}
```

## src/dns_client.h
```c
#ifndef DNS_CLIENT_H
#define DNS_CLIENT_H

#include <zephyr/net/dns_resolve.h>

int dns_init(void);
int dns_resolve_hostname(const char *hostname, struct sockaddr *addr);

#endif /* DNS_CLIENT_H */
```

## src/emergency_handler.c
```c
#include <zephyr/kernel.h>
#include <zephyr/logging/log.h>
#include "emergency_handler.h"
#include "error_handler.h"
#include "asil.h"

LOG_MODULE_REGISTER(emergency_handler, CONFIG_EMERGENCY_LOG_LEVEL);

#define MAX_EMERGENCY_RETRIES 3
#define EMERGENCY_BACKOFF_MS 100

static atomic_t emergency_state = ATOMIC_INIT(EMERGENCY_STATE_NORMAL);
static uint32_t emergency_count = 0;
static K_MUTEX_DEFINE(emergency_mutex);

void handle_emergency_event(uint32_t event_type, const uint8_t *data, uint16_t len) {
    k_mutex_lock(&emergency_mutex, K_FOREVER);
    emergency_count++;
    
    // Log emergency event details
    LOG_ERR("Emergency event %d detected, count: %d", event_type, emergency_count);
    LOG_HEXDUMP_ERR(data, len, "Event data");
    
    // Update emergency state with atomic operation
    atomic_set(&emergency_state, EMERGENCY_STATE_ACTIVE);
    
    bool recovered = false;
    uint8_t retry_count = 0;
    
    while (!recovered && retry_count < MAX_EMERGENCY_RETRIES) {
        LOG_INF("Emergency recovery attempt %d", retry_count + 1);
        
        switch (event_type) {
            case EMERGENCY_COLLISION_RISK:
                recovered = handle_collision_risk(data, len);
                break;
                
            case EMERGENCY_BRAKE_FAILURE:
                recovered = handle_brake_failure(data, len);
                break;
                
            case EMERGENCY_SENSOR_ERROR:
                recovered = handle_sensor_emergency(data, len);
                break;
                
            case EMERGENCY_SYSTEM_ERROR:
                recovered = handle_system_emergency(data, len);
                break;
                
            case EMERGENCY_COMMUNICATION_ERROR:
                recovered = handle_communication_emergency(data, len);
                break;
                
            default:
                LOG_ERR("Unknown emergency event type: %d", event_type);
                k_mutex_unlock(&emergency_mutex);
                enter_safe_state();
                return;
        }
        
        if (!recovered) {
            retry_count++;
            // Exponential backoff between retries
            k_sleep(K_MSEC(EMERGENCY_BACKOFF_MS * (1 << retry_count)));
        }
    }
    
    if (recovered) {
        LOG_INF("Emergency event %d recovered after %d attempts", 
                event_type, retry_count + 1);
        atomic_set(&emergency_state, EMERGENCY_STATE_NORMAL);
        emergency_count = 0;
    } else {
        LOG_ERR("Failed to recover from emergency event %d after %d attempts", 
                event_type, MAX_EMERGENCY_RETRIES);
        k_mutex_unlock(&emergency_mutex);
        enter_safe_state();
        return;
    }
    
    k_mutex_unlock(&emergency_mutex);
}

static bool handle_collision_risk(const uint8_t *data, uint16_t len) {
    struct collision_data *collision = (struct collision_data *)data;
    
    // Validate data
    if (len < sizeof(struct collision_data)) {
        LOG_ERR("Invalid collision data size");
        return false;
    }
    
    LOG_WRN("Collision risk detected: distance=%d mm, velocity=%d mm/s",
            collision->distance, collision->relative_velocity);
    
    // Emergency brake activation
    if (activate_emergency_brake() != 0) {
        LOG_ERR("Failed to activate emergency brake");
        return false;
    }
    
    // Verify brake activation
    if (!verify_brake_state()) {
        LOG_ERR("Emergency brake activation verification failed");
        return false;
    }
    
    return true;
}

static bool handle_brake_failure(const uint8_t *data, uint16_t len) {
    struct brake_status *status = (struct brake_status *)data;
    
    if (len < sizeof(struct brake_status)) {
        LOG_ERR("Invalid brake status data size");
        return false;
    }
    
    LOG_ERR("Brake failure detected: pressure=%d kPa, status=0x%x",
            status->pressure, status->error_flags);
    
    // Try brake system reset
    if (reset_brake_system() != 0) {
        LOG_ERR("Brake system reset failed");
        return false;
    }
    
    // Switch to backup brake system if available
    if (status->backup_available) {
        if (activate_backup_brake() != 0) {
            LOG_ERR("Backup brake activation failed");
            return false;
        }
    }
    
    return verify_brake_redundancy();
}

static bool handle_sensor_emergency(const uint8_t *data, uint16_t len) {
    struct sensor_error *error = (struct sensor_error *)data;
    
    if (len < sizeof(struct sensor_error)) {
        LOG_ERR("Invalid sensor error data size");
        return false;
    }
    
    LOG_ERR("Critical sensor error: sensor_id=0x%x, error=0x%x",
            error->sensor_id, error->error_code);
    
    // Try sensor recovery
    if (recover_sensor(error->sensor_id) != 0) {
        // Switch to redundant sensor if available
        if (!switch_to_redundant_sensor(error->sensor_id)) {
            LOG_ERR("Failed to switch to redundant sensor");
            return false;
        }
    }
    
    return verify_sensor_readings(error->sensor_id);
}

static bool handle_system_emergency(const uint8_t *data, uint16_t len) {
    struct system_error *error = (struct system_error *)data;
    
    if (len < sizeof(struct system_error)) {
        LOG_ERR("Invalid system error data size");
        return false;
    }
    
    LOG_ERR("System emergency: component=0x%x, error=0x%x",
            error->component_id, error->error_code);
    
    // Try component reset
    if (reset_system_component(error->component_id) != 0) {
        LOG_ERR("Component reset failed");
        return false;
    }
    
    // Verify system state
    return verify_system_state(error->component_id);
}

static bool handle_communication_emergency(const uint8_t *data, uint16_t len) {
    struct comm_error *error = (struct comm_error *)data;
    
    if (len < sizeof(struct comm_error)) {
        LOG_ERR("Invalid communication error data size");
        return false;
    }
    
    LOG_ERR("Communication emergency: interface=0x%x, error=0x%x",
            error->interface_id, error->error_code);
    
    // Reset communication interface
    if (reset_comm_interface(error->interface_id) != 0) {
        LOG_ERR("Communication interface reset failed");
        return false;
    }
    
    // Try fallback communication path
    if (activate_comm_fallback(error->interface_id) != 0) {
        LOG_ERR("Fallback communication activation failed");
        return false;
    }
    
    return verify_communication_state(error->interface_id);
}

uint32_t get_emergency_state(void) {
    return atomic_get(&emergency_state);
}

uint32_t get_emergency_count(void) {
    k_mutex_lock(&emergency_mutex, K_FOREVER);
    uint32_t count = emergency_count;
    k_mutex_unlock(&emergency_mutex);
    return count;
}
```

## src/mqtt_handler.c
```c
#include "mqtt_handler.h"
#include <zephyr/net/socket.h>
#include <zephyr/random/rand32.h>

#define MQTT_CLIENTID "vcu-%08x"
#define MQTT_BROKER_HOSTNAME "broker.emq.io"
#define MQTT_BROKER_PORT 1883

static uint8_t rx_buffer[1024];
static uint8_t tx_buffer[1024];

void mqtt_client_init(struct mqtt_client *client) {
    struct sockaddr_in broker;
    char clientid[32];

    snprintf(clientid, sizeof(clientid), MQTT_CLIENTID,
             sys_rand32_get());

    broker.sin_family = AF_INET;
    broker.sin_port = htons(MQTT_BROKER_PORT);
    net_addr_pton(AF_INET, MQTT_BROKER_HOSTNAME, &broker.sin_addr);

    mqtt_client_init(client);

    client->broker = &broker;
    client->evt_cb = mqtt_evt_handler;
    client->client_id.utf8 = clientid;
    client->client_id.size = strlen(clientid);
    client->password = NULL;
    client->user_name = NULL;
    client->protocol_version = MQTT_VERSION_3_1_1;
    client->rx_buf = rx_buffer;
    client->rx_buf_size = sizeof(rx_buffer);
    client->tx_buf = tx_buffer;
    client->tx_buf_size = sizeof(tx_buffer);
}

void mqtt_evt_handler(struct mqtt_client *client, struct mqtt_evt *evt) {
    switch (evt->type) {
        case MQTT_EVT_CONNACK:
            if (evt->result == 0) {
                subscribe_to_topics();
            }
            break;
            
        case MQTT_EVT_DISCONNECT:
            handle_error(ERROR_MQTT_DISCONNECT);
            k_work_schedule(&mqtt_work, K_SECONDS(5));
            break;
            
        case MQTT_EVT_PUBACK:
            if (evt->result != 0) {
                handle_error(ERROR_MQTT_PUBLISH);
            }
            break;
            
        case MQTT_EVT_SUBACK:
            if (evt->result != 0) {
                handle_error(ERROR_MQTT_SUBSCRIBE);
            }
            break;
            
        case MQTT_EVT_PUBLISH:
            handle_incoming_mqtt_message(evt);
            break;
    }
}

void mqtt_connect_work_handler(struct k_work *work) {
    int ret = mqtt_connect(&mqtt_client);
    if (ret < 0) {
        handle_error(ERROR_MQTT_CONNECT);
        k_work_schedule(&mqtt_work, K_SECONDS(5));
    }
}

void publish_sensor_data(const char *topic, float value) {
    char payload[32];
    struct mqtt_publish_param param;

    snprintf(payload, sizeof(payload), "%.2f", value);

    param.message.topic.qos = 1;
    param.message.topic.topic.utf8 = topic;
    param.message.topic.topic.size = strlen(topic);
    param.message.payload.data = payload;
    param.message.payload.len = strlen(payload);
    param.message_id = sys_rand32_get();
    param.dup_flag = 0;
    param.retain_flag = 0;

    mqtt_publish(&client, &param);
}

void publish_to_topic(const char *topic, const char *payload)
{
    struct mqtt_publish_param param = {
        .message.topic.qos = 1,
        .message.topic.topic.utf8 = topic,
        .message.topic.topic.size = strlen(topic),
        .message.payload.data = payload,
        .message.payload.len = strlen(payload),
        .message_id = sys_rand32_get(),
        .dup_flag = 0,
        .retain_flag = 0
    };

    mqtt_publish(mqtt_client, &param);
}

void subscribe_to_topics(void)
{
    static struct mqtt_topic_list topics = {
        .list = {
            { .topic = { .utf8 = TOPIC_V2I } },
            { .topic = { .utf8 = TOPIC_TRAFFIC_UPDATE } },
            { .topic = { .utf8 = TOPIC_HAZARD_NOTIFICATION } }
        },
        .count = 3
    };
    
    mqtt_subscribe(mqtt_client, &topics);
}
```

## src/mqtt_handler.h
```c
#ifndef MQTT_HANDLER_H
#define MQTT_HANDLER_H

#include <zephyr/net/mqtt.h>

void mqtt_client_init(struct mqtt_client *client);
void publish_sensor_data(const char *topic, float value);
void publish_gps_data(const char *topic, float lat, float lon);
void subscribe_to_topics(void);
void mqtt_connect_work_handler(struct k_work *work);

#endif /* MQTT_HANDLER_H */
```

## src/road_monitor.c
```c
#include "road_monitor.h"
#include "v2x_router.h"

#define MAX_ROAD_SEGMENTS 32

static struct road_segment segments[MAX_ROAD_SEGMENTS];
static uint8_t num_segments = 0;

void road_monitor_init(void) {
    memset(segments, 0, sizeof(segments));
}

void update_road_condition(struct road_segment *segment) {
    // Find or add segment
    for (int i = 0; i < num_segments; i++) {
        if (segments[i].segment_id == segment->segment_id) {
            memcpy(&segments[i], segment, sizeof(struct road_segment));
            if (is_hazardous_condition(segment->condition)) {
                broadcast_road_hazard(segment->segment_id, segment->condition);
            }
            return;
        }
    }

    // Add new segment if space available
    if (num_segments < MAX_ROAD_SEGMENTS) {
        memcpy(&segments[num_segments++], segment, sizeof(struct road_segment));
    }
}

void broadcast_road_hazard(uint32_t segment_id, uint8_t hazard_type) {
    struct v2x_message msg = {
        .msg_type = V2X_MSG_ROAD_HAZARD,
        .priority = 1,
        .timestamp = k_uptime_get(),
    };
    
    struct road_hazard_data {
        uint32_t segment_id;
        uint8_t type;
        float location[2];
    } hazard = {
        .segment_id = segment_id,
        .type = hazard_type,
    };
    
    get_segment_location(segment_id, hazard.location);
    memcpy(msg.data, &hazard, sizeof(hazard));
    msg.data_len = sizeof(hazard);
    
    v2x_route_message(&msg);
}
```

## src/road_monitor.h
```c
#ifndef ROAD_MONITOR_H
#define ROAD_MONITOR_H

#define ROAD_CONDITION_NORMAL  0
#define ROAD_CONDITION_WET     1
#define ROAD_CONDITION_ICY     2
#define ROAD_CONDITION_FOG     3

struct road_segment {
    uint32_t segment_id;
    uint8_t condition;
    float friction;
    float visibility;
    uint32_t last_update;
};

void road_monitor_init(void);
void update_road_condition(struct road_segment *segment);
void broadcast_road_hazard(uint32_t segment_id, uint8_t hazard_type);

#endif /* ROAD_MONITOR_H */
```

## src/traffic_manager.c
```c
#include "traffic_manager.h"
#include "v2x_router.h"

#define MAX_TRAFFIC_LIGHTS 32
#define MAX_INTERSECTIONS 16

struct traffic_light {
    uint32_t id;
    uint8_t state;
    uint32_t timing;
    float distance;
    struct {
        float latitude;
        float longitude;
    } location;
};

static struct traffic_light traffic_lights[MAX_TRAFFIC_LIGHTS];
static uint8_t num_lights = 0;

void traffic_manager_init(void) {
    memset(traffic_lights, 0, sizeof(traffic_lights));
    register_v2x_handler(V2X_MSG_TRAFFIC, handle_traffic_message);
}

void handle_traffic_light_update(struct traffic_light *light) {
    // Update local traffic light state
    for (int i = 0; i < num_lights; i++) {
        if (traffic_lights[i].id == light->id) {
            memcpy(&traffic_lights[i], light, sizeof(struct traffic_light));
            calculate_approach_speed(light);
            broadcast_traffic_state(light);
            break;
        }
    }
}
```

## src/v2i_handler.c
```c
#include "v2i_handler.h"
#include "mqtt_handler.h"
#include <zephyr/data/json.h>

static struct v2i_context {
    bool traffic_light_state;
    uint8_t road_condition;
    uint16_t traffic_flow;
} v2i_ctx;

void v2i_init(void) {
    memset(&v2i_ctx, 0, sizeof(v2i_ctx));
    subscribe_to_v2i_topics();
}

int send_v2i_data(uint8_t type, const uint8_t *data, uint16_t len) {
    char json_buffer[256];
    switch(type) {
        case V2I_TRAFFIC_LIGHT:
            snprintf(json_buffer, sizeof(json_buffer), 
                    "{\"type\":\"traffic_light\",\"state\":%d}", data[0]);
            break;
        case V2I_ROAD_CONDITION:
            snprintf(json_buffer, sizeof(json_buffer), 
                    "{\"type\":\"road_condition\",\"condition\":%d}", data[0]);
            break;
        case V2I_TRAFFIC_FLOW:
            snprintf(json_buffer, sizeof(json_buffer), 
                    "{\"type\":\"traffic_flow\",\"density\":%d}", 
                    (data[0] << 8) | data[1]);
            break;
    }
    return publish_to_topic(TOPIC_V2I, json_buffer);
}

static void handle_traffic_light_data(const struct json_obj_token *token) {
    uint8_t light_state;
    float distance;
    
    // Parse traffic light data
    json_decode_uint8(token, "state", &light_state);
    json_decode_float(token, "distance", &distance);
    
    // Update local context
    v2i_ctx.traffic_light_state = light_state;
    
    // Handle traffic light state
    switch (light_state) {
        case LIGHT_RED:
            if (distance < CRITICAL_DISTANCE) {
                trigger_brake_warning();
            }
            break;
            
        case LIGHT_YELLOW:
            calculate_stopping_distance(distance);
            break;
    }
}

static void calculate_stopping_distance(float distance) {
    float current_speed = get_current_speed();
    float brake_distance = (current_speed * current_speed) / (2 * BRAKE_DECELERATION);
    
    if (brake_distance > distance) {
        trigger_brake_warning();
        adjust_speed_for_traffic_light(distance);
    }
}

static void handle_road_condition_data(const struct json_obj_token *token) {
    uint8_t condition;
    float friction;
    
    json_decode_uint8(token, "condition", &condition);
    json_decode_float(token, "friction", &friction);
    
    // Update local context
    v2i_ctx.road_condition = condition;
    
    // Adjust vehicle parameters based on road condition
    switch (condition) {
        case ROAD_ICY:
            adjust_traction_control(friction);
            broadcast_road_hazard();
            break;
            
        case ROAD_WET:
            adjust_abs_parameters();
            break;
    }
}

static void adjust_traction_control(float friction) {
    struct traction_params params = {
        .friction_coefficient = friction,
        .stability_threshold = calculate_stability_threshold(friction)
    };
    
    apply_traction_control(&params);
}

static void handle_traffic_flow_data(const struct json_obj_token *token) {
    uint16_t density;
    float avg_speed;
    
    json_decode_uint16(token, "density", &density);
    json_decode_float(token, "avg_speed", &avg_speed);
    
    // Update traffic flow context
    v2i_ctx.traffic_flow = density;
    
    // Optimize route based on traffic flow
    if (density > HIGH_TRAFFIC_THRESHOLD) {
        suggest_alternate_route();
        notify_traffic_congestion();
    }
}

static void notify_traffic_congestion(void) {
    struct v2x_message msg = {
        .msg_type = V2X_MSG_TRAFFIC,
        .priority = 1,
        .data_len = sizeof(struct traffic_info)
    };
    
    struct traffic_info info = {
        .location = get_current_location(),
        .speed = get_current_speed(),
        .density = calculate_traffic_density()
    };
    
    memcpy(msg.data, &info, sizeof(info));
    v2x_route_message(&msg);
}

void process_v2i_message(const uint8_t *data, uint16_t len) {
    struct json_obj_token token;
    
    if (json_obj_parse(data, len, &token) == 0) {
        char type[32];
        json_decode_string(&token, "type", type, sizeof(type));
        
        if (strcmp(type, "traffic_light") == 0) {
            handle_traffic_light_data(&token);
        } else if (strcmp(type, "road_condition") == 0) {
            handle_road_condition_data(&token);
        } else if (strcmp(type, "traffic_flow") == 0) {
            handle_traffic_flow_data(&token);
        }
        
        // Update traffic management system
        update_traffic_management_system(&token);
    }
}
```

## src/v2i_handler.h
```c
#ifndef V2I_HANDLER_H
#define V2I_HANDLER_H

#include <zephyr/net/mqtt.h>

// V2I message types
#define V2I_TRAFFIC_LIGHT    0x01
#define V2I_ROAD_CONDITION   0x02
#define V2I_TRAFFIC_FLOW     0x03

void v2i_init(void);
int send_v2i_data(uint8_t type, const uint8_t *data, uint16_t len);
void process_v2i_message(const uint8_t *data, uint16_t len);

#endif /* V2I_HANDLER_H */
```

## src/v2x_handler.c
```c
#include "v2x_handler.h"
#include <zephyr/bluetooth/uuid.h>
#include <zephyr/bluetooth/gatt.h>

#define MAX_V2V_PAYLOAD 240
#define V2V_SERVICE_UUID BT_UUID_DECLARE_16(0xFF00)
#define V2V_DATA_UUID    BT_UUID_DECLARE_16(0xFF01)

static struct bt_le_adv_param adv_param = BT_LE_ADV_PARAM(
    BT_LE_ADV_OPT_CONNECTABLE,
    BT_GAP_ADV_FAST_INT_MIN_2,
    BT_GAP_ADV_FAST_INT_MAX_2,
    NULL);

// V2V GATT service definition
BT_GATT_SERVICE_DEFINE(v2v_svc,
    BT_GATT_PRIMARY_SERVICE(V2V_SERVICE_UUID),
    BT_GATT_CHARACTERISTIC(V2V_DATA_UUID,
                          BT_GATT_CHRC_WRITE_WITHOUT_RESP | BT_GATT_CHRC_NOTIFY,
                          BT_GATT_PERM_WRITE,
                          NULL, NULL, NULL),
);

static struct bt_le_ext_adv *adv;

void v2x_init(void) {
    int err;

    // Initialize extended advertising
    err = bt_le_ext_adv_create(&adv_param, NULL, &adv);
    if (err) {
        return;
    }

    // Start advertising
    err = bt_le_ext_adv_start(adv, BT_LE_EXT_ADV_START_PARAM);
    if (err) {
        return;
    }
}

int broadcast_v2v_data(uint8_t type, const uint8_t *data, uint16_t len) {
    uint8_t v2v_packet[MAX_V2V_PAYLOAD];
    if (len + 1 > MAX_V2V_PAYLOAD) {
        return -EINVAL;
    }

    // Construct V2V packet
    v2v_packet[0] = type;
    memcpy(&v2v_packet[1], data, len);

    // Broadcast using BLE advertising data
    struct bt_data ad[] = {
        BT_DATA_BYTES(BT_DATA_MANUFACTURER_DATA, 
                     (v2v_packet[0] & 0xFF),
                     (v2v_packet[1] & 0xFF)),
        BT_DATA(BT_DATA_SVC_DATA16, &v2v_packet[2], len - 2),
    };

    return bt_le_ext_adv_set_data(adv, ad, ARRAY_SIZE(ad), NULL, 0);
}
```

## src/v2x_handler.h
```c
#ifndef V2X_HANDLER_H
#define V2X_HANDLER_H

#include <zephyr/bluetooth/bluetooth.h>
#include <zephyr/bluetooth/gatt.h>

// V2V message types
#define V2V_GPS_DATA      0x01
#define V2V_HAZARD_DATA   0x02
#define V2V_BRAKE_DATA    0x03
#define V2V_SPEED_DATA    0x04

void v2x_init(void);
int broadcast_v2v_data(uint8_t type, const uint8_t *data, uint16_t len);
void process_v2v_message(const uint8_t *data, uint16_t len);

#endif /* V2X_HANDLER_H */
```
